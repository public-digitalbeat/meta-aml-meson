## conf/machine/mesons4-lib32-ap222-vmx.conf
```bitbake
include conf/machine/mesons4-lib32-ap222.conf

DISTRO_FEATURES_append = " verimatrix "
DISTRO_FEATURES_append = " aml-cas "
```

## conf/machine/mesons4-lib32-ap229-vmx.conf
```bitbake
include conf/machine/mesons4_ap229.inc

UBOOT_MACHINE = "s4_ap229_s905c3eng_config"
TDK_VERSION_s4 = "v3.8/dev/S905C3ENG"
MEDIA_MODULES_UCODE_BIN_s4 = "firmware/S905C3ENG/video_ucode.bin"
#DISTRO_FEATURES_append = " verimatrix "
DISTRO_FEATURES_append = " aml-cas "
```

## conf/machine/mesonsc2-5.4-lib32-ah232-synamedia.conf
```bitbake
include conf/machine/mesonsc2_5.4_ah232.inc

DISTRO_FEATURES_append = " synamedia "

#For changed from s905c2 to S905C2ENG
TDK_VERSION_sc2 = "v3.8/dev/S905C2ENG"
MEDIA_MODULES_UCODE_BIN_sc2 = "firmware/S905C2ENG/video_ucode.bin"
TDK_VERSION_sc2-5.4 = "v3.8/dev/S905C2ENG"
MEDIA_MODULES_UCODE_BIN_sc2-5.4 = "firmware/S905C2ENG/video_ucode.bin"
```
